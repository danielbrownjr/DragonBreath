## components/pb_heater/Kconfig
```kconfig
choice PB_HEATER_PID_BACKEND
    prompt "Chamber PID backend"
    default PB_HEATER_PID_BACKEND_DC_PID
    help
        Select the generic PID math used by DragonBreath's chamber controller.
        Heater-only behavior, output shaping, and every safety veto remain owned
        by pb_heater regardless of this selection.

config PB_HEATER_PID_BACKEND_DC_PID
    bool "dragon-core dc_pid"
    help
        Use the shared dragon-core PID component. This is the default while
        upstream dragon-core PR #54 is being evaluated.

config PB_HEATER_PID_BACKEND_LEGACY
    bool "DragonBreath legacy pb_pid"
    help
        Retain the original product-local PID implementation as a build-time
        fallback if dc_pid is not accepted upstream or a regression is found.

endchoice
```

## components/pb_hil/Kconfig.projbuild
```kconfig
menu "DragonBreath development hardware"

config PB_DEVBOARD_SAFE
    bool "Compile out Panda-specific physical I/O"
    default n
    help
        Replace the Panda relay, fan, thermistor ADC, LEDs, buttons, and board
        strap backends with safe logical development-board backends. Production
        networking and the web UI remain enabled unless PB_HIL_DEVBOARD is also
        selected. Use this for native-USB debugging on a generic ESP32-C3 board.

config PB_HIL_CONSOLE
    bool "Enable the serial HIL command console"
    default n
    help
        Accept line-delimited JSON commands on the configured console UART and
        emit machine-readable DBHIL responses alongside normal ESP-IDF logs.
        This is intended for development and qualification images only.

config PB_HIL_DEVBOARD
    bool "Build for a safe ESP32-C3 development board"
    depends on PB_HIL_CONSOLE
    select PB_DEVBOARD_SAFE
    default n
    help
        Compile out every Panda mains GPIO write. Thermistors, zero-cross, and
        network state are supplied by the HIL console. Heater and fan outputs
        remain logical state only, so this image cannot energize Panda hardware.

endmenu
```
